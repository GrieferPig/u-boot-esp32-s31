// SPDX-License-Identifier: GPL-2.0+
/*
 * ESP32-P4 U-Boot device tree additions.
 *
 * The firmware images are assembled outside binman (the SPL is wrapped by
 * esptool into an ESP bootable image and U-Boot proper is flashed raw), so the
 * node only exists to satisfy the build.
 */

/ {
#if defined(CONFIG_ESP32P4_NOR_BOOTMETH) && !defined(CONFIG_SPL_BUILD)
	bootstd {
		compatible = "u-boot,boot-std";

		nor {
			compatible = "espressif,esp32p4-nor-bootmeth";
		};
	};
#endif

	binman: binman {
	};
};
