## arch/riscv/cpu/generic/Kconfig
```kconfig
# SPDX-License-Identifier: GPL-2.0+
#
# Copyright (C) 2018, Bin Meng <bmeng.cn@gmail.com>

config GENERIC_RISCV
	bool
	select BINMAN if SPL
	select ARCH_EARLY_INIT_R
	select SYS_CACHE_SHIFT_6
	imply CPU
	imply CPU_RISCV
	imply RISCV_TIMER if (RISCV_SMODE || SPL_RISCV_SMODE)
	# The ESP32-P4 has no ACLINT block; its timebase is the SYSTIMER.
	imply RISCV_ACLINT if RISCV_MMODE && !TARGET_ESP32P4
	imply SPL_RISCV_ACLINT if SPL_RISCV_MMODE && !TARGET_ESP32P4
	imply CMD_CPU
	imply SPL_CPU
	imply SPL_OPENSBI
	imply SPL_LOAD_FIT
```

## board/espressif/Kconfig
```kconfig
if ARCH_ESPRESSIF

choice
	prompt "Espressif target"
	default TARGET_ESP32S31

config TARGET_ESP32S31
    bool "ESP32-S31"

config TARGET_ESP32P4
	bool "ESP32-P4"
	help
	  Build the native RV32 M-mode bootloader for the Espressif ESP32-P4.
	  The revision 1.3 port loads SPL from SPI NOR and runs U-Boot proper
	  in internal SRAM.

endchoice

if TARGET_ESP32S31
source "board/espressif/esp32s31/Kconfig"
endif

if TARGET_ESP32P4
source "board/espressif/esp32p4/Kconfig"
endif

endif
```

## board/espressif/esp32p4/Kconfig
```kconfig
if TARGET_ESP32P4

config SYS_BOARD
	default "esp32p4"

config SYS_VENDOR
	default "espressif"

config SYS_CPU
	default "generic"

config SYS_CONFIG_NAME
	default "esp32p4"

config BOARD_SPECIFIC_OPTIONS
	def_bool y
	select GENERIC_RISCV
	select SUPPORT_SPL

config ESP32P4_SPL_PSRAM_200MHZ
	bool "Run rev1.3 AP Hex PSRAM at 200 MHz"
	depends on SPL
	help
	  Select the validated 200 MHz timing profile. The default
	  is the board's 80 MHz configuration.

config ESP32P4_SPL_FIT_PAYLOAD
	def_bool y
	depends on SPL
	select SPL_SHA256
	select SPL_OF_LIBFDT
	help
	  ROM enters U-Boot SPL directly. The FIT selects M-mode U-Boot,
	  RV32 Linux and its DTB; no ESP-IDF app loader or OpenSBI stage.

config ESP32P4_NOR_BOOTMETH
	def_bool y
	depends on ESP32P4_SRAM_ONLY && BOOTSTD && !SPL
	select BOOTMETH_GLOBAL

config ESP32P4_SPL_WDT_HANDOFF
	bool "Preserve watchdog ownership passed from the native SPL"
	depends on ESP32P4_SRAM_ONLY
	help
	  The paired SPL protects boot with the RTC watchdog until application
	  handoff. Do not subsequently disable the always-on super watchdog
	  or reset the timer-group watchdog registers from U-Boot proper.

config ESP32P4_SRAM_ONLY
	bool "Run U-Boot proper from internal SRAM"
	select BOARD_PRELOADED_RUNTIME
	help
	  Load U-Boot proper into the lower half of the HP SRAM (0x4ff00000) so
	  it does not depend on the PSRAM window the ROM leaves mapped.

endif
```

## board/espressif/esp32s31/Kconfig
```kconfig
if TARGET_ESP32S31

config SYS_BOARD
	default "esp32s31"

config SYS_VENDOR
	default "espressif"

config SYS_CPU
	default "generic"

config SYS_CONFIG_NAME
	default "esp32s31"

config BOARD_SPECIFIC_OPTIONS
	def_bool y
	select GENERIC_RISCV
	select SUPPORT_SPL

config ESP32S31_PSRAM_COMPAT_200MHZ
	bool "ESP32-S31 initial 200 MHz PSRAM compatibility profile"
	default n
	help
	  Select an experimental initial 400 MHz MPLL / 200 MHz MSPI
	  profile for boards on which the 500 MHz MPLL calibration stalls.
	  Enable the analog I2C gates early and use the ESP-IDF 200 MHz
	  latency settings. Bypass the 250 MHz training sequence. The
	  later EMAC MPLL setup is unchanged; steady-state PSRAM timing
	  and Ethernet operation require separate validation.

config ESP32S31_NOR_BOOTMETH
	def_bool y
	depends on BOOTSTD && CMD_BOOTI
	select BOOTMETH_GLOBAL

endif
```

## configs/espressif_esp32p4_defconfig
```kconfig
CONFIG_RISCV=y
CONFIG_SYS_ICACHE_OFF=y
CONFIG_SYS_DCACHE_OFF=y
CONFIG_TEXT_BASE=0x4ff00000
CONFIG_SYS_MALLOC_LEN=0x10000
CONFIG_SYS_MALLOC_F_LEN=0x2000
CONFIG_SPL_LDSCRIPT="board/espressif/esp32p4/u-boot-spl.lds"
CONFIG_HAS_CUSTOM_SYS_INIT_SP_ADDR=y
CONFIG_CUSTOM_SYS_INIT_SP_ADDR=0x4ff3bfc0
CONFIG_DEFAULT_DEVICE_TREE="esp32p4"
CONFIG_SPL_TEXT_BASE=0x4ff2b000
CONFIG_SPL_BSS_START_ADDR=0x4ff36000
CONFIG_SPL_BSS_MAX_SIZE=0x2800
CONFIG_SPL_SIZE_LIMIT=0xb000
CONFIG_SPL=y
CONFIG_SYS_LOAD_ADDR=0x48000000
CONFIG_ARCH_ESPRESSIF=y
CONFIG_TARGET_ESP32P4=y
CONFIG_ESP32P4_SPL_WDT_HANDOFF=y
CONFIG_ESP32P4_SRAM_ONLY=y
CONFIG_CMODEL_MEDANY=y
# CONFIG_RISCV_ISA_F is not set
# CONFIG_SPL_SMP is not set
# CONFIG_SYS_MALLOC_CLEAR_ON_INIT is not set
CONFIG_USE_BOOTCOMMAND=y
CONFIG_BOOTCOMMAND="bootflow scan"
CONFIG_BOARD_LATE_INIT=y
CONFIG_SPL_FRAMEWORK_BOARD_INIT_F=y
CONFIG_SPL_MAX_SIZE=0xb000
CONFIG_SPL_BOARD_INIT=y
CONFIG_SPL_NOR_SUPPORT=y
CONFIG_SYS_PROMPT="esp32p4> "
# CONFIG_CMD_BOOTI is not set
# CONFIG_CMD_FDT is not set
# CONFIG_NET is not set
CONFIG_SPL_DM_SEQ_ALIAS=y
CONFIG_ESP_SERIAL=y
# CONFIG_SPL_TIMER is not set
CONFIG_TIMER_EARLY=y
CONFIG_SHA256=y
CONFIG_SHA256_SMALL=y
# CONFIG_GZIP is not set
CONFIG_SPL_OF_LIBFDT_ASSUME_MASK=0x0
# CONFIG_EFI_LOADER is not set
```

## configs/espressif_esp32p4_low_defconfig
```kconfig
CONFIG_RISCV=y
CONFIG_ESP32P4_LOW_RAM_TOP=y
# CONFIG_TARGET_ESP32S31 is not set
CONFIG_ARCH_ESPRESSIF=y
CONFIG_TARGET_ESP32P4=y
CONFIG_RISCV_MMODE=y
CONFIG_CMODEL_MEDANY=y
# CONFIG_RISCV_ISA_F is not set
# CONFIG_RISCV_ACLINT is not set
CONFIG_TEXT_BASE=0x48000000
CONFIG_SYS_MALLOC_LEN=0x20000
CONFIG_SYS_MALLOC_F_LEN=0x4000
CONFIG_HAS_CUSTOM_SYS_INIT_SP_ADDR=y
CONFIG_CUSTOM_SYS_INIT_SP_ADDR=0x480e0000
CONFIG_DEFAULT_DEVICE_TREE="esp32p4"
CONFIG_SYS_LOAD_ADDR=0x48000000
CONFIG_OF_SEPARATE=y
# CONFIG_TIMER is not set
# CONFIG_BOOTSTD is not set
CONFIG_BOOTDELAY=2
CONFIG_USE_BOOTCOMMAND=y
CONFIG_BOOTCOMMAND="booti 0x48000000 - 0x48f00000"
CONFIG_BOARD_LATE_INIT=y
CONFIG_SYS_PROMPT="esp32p4> "
CONFIG_CMD_BOOTI=y
CONFIG_CMD_FDT=y
CONFIG_CMD_MEMTEST=y
# CONFIG_CMD_NET is not set
# CONFIG_NET is not set
# CONFIG_EFI_LOADER is not set
# CONFIG_GZIP is not set
CONFIG_ESP_SERIAL=y
CONFIG_CC_OPTIMIZE_FOR_SIZE=y
# CONFIG_CC_OPTIMIZE_FOR_SPEED is not set
# CONFIG_SMP is not set
```

## configs/espressif_esp32p4_spl_defconfig
```kconfig
CONFIG_RISCV=y
CONFIG_SYS_ICACHE_OFF=y
CONFIG_SYS_DCACHE_OFF=y
CONFIG_TEXT_BASE=0x48c00000
CONFIG_SYS_MALLOC_LEN=0x40000
CONFIG_SPL_LDSCRIPT="board/espressif/esp32p4/u-boot-spl.lds"
CONFIG_HAS_CUSTOM_SYS_INIT_SP_ADDR=y
CONFIG_CUSTOM_SYS_INIT_SP_ADDR=0x4ff3bfc0
CONFIG_DEFAULT_DEVICE_TREE="esp32p4"
CONFIG_SPL_TEXT_BASE=0x4ff2b000
CONFIG_SPL_SYS_MALLOC_F_LEN=0x2000
CONFIG_SPL_BSS_START_ADDR=0x4ff36000
CONFIG_SPL_BSS_MAX_SIZE=0x2800
CONFIG_SPL_SIZE_LIMIT=0xb000
CONFIG_SPL=y
CONFIG_SYS_LOAD_ADDR=0x48000000
CONFIG_ARCH_ESPRESSIF=y
CONFIG_TARGET_ESP32P4=y
CONFIG_CMODEL_MEDANY=y
# CONFIG_RISCV_ISA_F is not set
# CONFIG_SPL_SMP is not set
# CONFIG_BOOTSTD is not set
CONFIG_USE_BOOTCOMMAND=y
CONFIG_BOOTCOMMAND="booti 0x48000000 - 0x48f00000"
CONFIG_BOARD_LATE_INIT=y
CONFIG_SPL_FRAMEWORK_BOARD_INIT_F=y
CONFIG_SPL_MAX_SIZE=0xb000
CONFIG_SPL_BOARD_INIT=y
CONFIG_SPL_NOR_SUPPORT=y
CONFIG_SYS_PROMPT="esp32p4> "
CONFIG_CMD_MEMTEST=y
# CONFIG_NET is not set
CONFIG_SPL_DM_SEQ_ALIAS=y
CONFIG_ESP_SERIAL=y
# CONFIG_TIMER is not set
CONFIG_SPL_OF_LIBFDT_ASSUME_MASK=0x0
# CONFIG_EFI_LOADER is not set
```

## configs/espressif_esp32p4_sram_defconfig
```kconfig
CONFIG_RISCV=y
CONFIG_SYS_ICACHE_OFF=y
CONFIG_SYS_DCACHE_OFF=y
CONFIG_TEXT_BASE=0x4ff00000
CONFIG_SYS_MALLOC_LEN=0x10000
CONFIG_SYS_MALLOC_F_LEN=0x2000
CONFIG_HAS_CUSTOM_SYS_INIT_SP_ADDR=y
CONFIG_CUSTOM_SYS_INIT_SP_ADDR=0x4ff3bfc0
CONFIG_DEFAULT_DEVICE_TREE="esp32p4"
CONFIG_SYS_LOAD_ADDR=0x48000000
CONFIG_ARCH_ESPRESSIF=y
CONFIG_TARGET_ESP32P4=y
CONFIG_ESP32P4_SPL_WDT_HANDOFF=y
CONFIG_ESP32P4_SRAM_ONLY=y
CONFIG_CMODEL_MEDANY=y
# CONFIG_RISCV_ISA_F is not set
# CONFIG_SYS_MALLOC_CLEAR_ON_INIT is not set
CONFIG_USE_BOOTCOMMAND=y
CONFIG_BOOTCOMMAND="bootflow scan"
CONFIG_BOARD_LATE_INIT=y
CONFIG_SYS_PROMPT="esp32p4> "
# CONFIG_CMD_BOOTI is not set
# CONFIG_CMD_FDT is not set
# CONFIG_NET is not set
CONFIG_ESP_SERIAL=y
CONFIG_TIMER_EARLY=y
CONFIG_SHA256=y
CONFIG_SHA256_SMALL=y
# CONFIG_GZIP is not set
# CONFIG_EFI_LOADER is not set
```
